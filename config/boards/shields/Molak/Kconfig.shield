## config/boards/shields/Molak/Kconfig.shield
```kconfig
config SHIELD_MOLAK_R
    def_bool $(shields_list_contains,Molak_R)

config SHIELD_MOLAK_L
    def_bool $(shields_list_contains,Molak_L)
```

## config/boards/shields/MolakFold/Kconfig.shield
```kconfig
config SHIELD_MolakFold_R
    def_bool $(shields_list_contains,MolakFold_R)

config SHIELD_MolakFold_L
    def_bool $(shields_list_contains,MolakFold_L)
```
